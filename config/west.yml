## config/west.yml
```yaml
manifest:
  remotes:
    - name: zmkfirmware
      url-base: https://github.com/zmkfirmware
  projects:
    - name: zmk
      remote: zmkfirmware
      revision: main     # Points to the latest ZMK features and fixes
      import: app/west.yml
  self:
    path: config
```
